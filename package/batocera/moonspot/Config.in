## package/batocera/moonspot/Config.in
```kconfig
menuconfig BR2_PACKAGE_BATOCERA_MOONSPOT
	bool "Moon Spot Packages"
	help
	  Moon Spot branded arcade kiosk packages

if BR2_PACKAGE_BATOCERA_MOONSPOT

source "$BR2_EXTERNAL_BATOCERA_PATH/package/batocera/moonspot/moonspot-splash/Config.in"
source "$BR2_EXTERNAL_BATOCERA_PATH/package/batocera/moonspot/moonspot-kiosk/Config.in"
source "$BR2_EXTERNAL_BATOCERA_PATH/package/batocera/moonspot/moonspot-backend/Config.in"
source "$BR2_EXTERNAL_BATOCERA_PATH/package/batocera/moonspot/moonspot-signage/Config.in"

endif # BR2_PACKAGE_BATOCERA_MOONSPOT
```

## package/batocera/moonspot/moonspot-backend/Config.in
```kconfig
config BR2_PACKAGE_MOONSPOT_BACKEND
	bool "moonspot-backend"
	select BR2_PACKAGE_PYTHON3
	select BR2_PACKAGE_PYTHON_FLASK
	select BR2_PACKAGE_PYTHON_FLASK_CORS
	help
	  Moon Spot backend API for content and ROM management
```

## package/batocera/moonspot/moonspot-kiosk/Config.in
```kconfig
config BR2_PACKAGE_MOONSPOT_KIOSK
	bool "moonspot-kiosk"
	help
	  Moon Spot kiosk mode with settings lockdown and ROM rotation management
```

## package/batocera/moonspot/moonspot-signage/Config.in
```kconfig
config BR2_PACKAGE_MOONSPOT_SIGNAGE
	bool "moonspot-signage"
	select BR2_PACKAGE_MPV
	help
	  Moon Spot digital signage for second screen display
```

## package/batocera/moonspot/moonspot-splash/Config.in
```kconfig
config BR2_PACKAGE_MOONSPOT_SPLASH
	bool "moonspot-splash"
	help
	  Moon Spot branded splash screens and video content
```
